## config/boards/shields/discipline/Kconfig.defconfig
```kconfig
if DISCIPLINE_DONGLE

config ZMK_KEYBOARD_NAME
	default "discipline dongle"

config ZMK_SPLIT_BLE_ROLE_CENTRAL
	default y
	
config ZMK_USB
	default y

endif


if DISCIPLINE_BOARD

config ZMK_KEYBOARD_NAME
	default "discipline board"

config ZMK_BLE
	default y

endif
```

## config/boards/shields/discipline/Kconfig.shield
```kconfig
config DISCIPLINE_DONGLE
	def_bool $(shields_list_contains, discipline_dongle)

config DISCIPLINE_BOARD
	def_bool $(shields_list_contains, discipline_board)
```
