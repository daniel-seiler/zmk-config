/ {
	chosen {
		zmk,kscan = &mock_kscan;
	};

	mock_kscan: mock_kscan_0 {
        compatible = "zmk,kscan-mock";
        columns = <0>;
        rows = <0>;
        events = <0>;
    };

	kscan0: kscan {
		compatible = "zmk,kscan-gpio-matrix";
		label = "KSCAN";
		diode-direction = "col2row";
		debounce-press-ms = <5>;
		debounce-release-ms = <5>;
		debounce-scan-period-ms = <1>;
		poll-period-ms = <10>;

		col-gpios
			= <&gpio0 2 GPIO_ACTIVE_HIGH>
			, <&gpio0 10 GPIO_ACTIVE_HIGH>
			, <&gpio1 4 GPIO_ACTIVE_HIGH>
			, <&gpio0 9 GPIO_ACTIVE_HIGH>
			, <&gpio1 6 GPIO_ACTIVE_HIGH>
			, <&gpio0 31 GPIO_ACTIVE_HIGH>
			, <&gpio0 29 GPIO_ACTIVE_HIGH>
			, <&gpio0 24 GPIO_ACTIVE_HIGH>
			, <&gpio0 22 GPIO_ACTIVE_HIGH>
			, <&gpio0 20 GPIO_ACTIVE_HIGH>
			, <&gpio0 17 GPIO_ACTIVE_HIGH>
			, <&gpio0 11 GPIO_ACTIVE_HIGH>
			, <&gpio1 0 GPIO_ACTIVE_HIGH>
			, <&gpio0 8 GPIO_ACTIVE_HIGH>
			, <&gpio0 6 GPIO_ACTIVE_HIGH>
			;

		row-gpios
			= <&gpio1 11 (GPIO_ACTIVE_HIGH | GPIO_PULL_DOWN)>
			, <&gpio1 15 (GPIO_ACTIVE_HIGH | GPIO_PULL_DOWN)>
			, <&gpio1 2 (GPIO_ACTIVE_HIGH | GPIO_PULL_DOWN)>
			, <&gpio1 13 (GPIO_ACTIVE_HIGH | GPIO_PULL_DOWN)>
			, <&gpio1 1 (GPIO_ACTIVE_HIGH | GPIO_PULL_DOWN)>
			;
	};
};
